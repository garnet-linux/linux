## Documentation/devicetree/bindings/clock/qcom,gcc-sm7435.yaml
```yaml
# SPDX-License-Identifier: (GPL-2.0-only OR BSD-2-Clause)
%YAML 1.2
---
$id: http://devicetree.org/schemas/clock/qcom,gcc-sm7435.yaml#
$schema: http://devicetree.org/meta-schemas/core.yaml#

title: Qualcomm Global Clock & Reset Controller on SM7435

maintainers:
  - Ximi <ximiyadka124@proton.me>
    # GitHub: @garnet-linux (organisation), @ximiyadka123 (personal)

description: |
  Qualcomm global clock control module provides the clocks, resets and power
  domains on SM7435.

  Only the clocks needed by the UFS host controller and the QMP UFS PHY are
  implemented at the moment.

  See also: include/dt-bindings/clock/qcom,gcc-sm7435.h

properties:
  compatible:
    enum:
      - qcom,gcc-sm7435

  clocks:
    items:
      - description: 19.2 MHz TCXO
      - description: UFS Phy Rx symbol 0 clock source
      - description: UFS Phy Rx symbol 1 clock source
      - description: UFS Phy Tx symbol 0 clock source
    minItems: 1
    maxItems: 4

  clock-names:
    items:
      - const: bi_tcxo
      - const: ufs_phy_rx_symbol_0_clk
      - const: ufs_phy_rx_symbol_1_clk
      - const: ufs_phy_tx_symbol_0_clk
    minItems: 1
    maxItems: 4

required:
  - compatible
  - clocks
  - clock-names
  - '#power-domain-cells'

allOf:
  - $ref: qcom,gcc.yaml#

unevaluatedProperties: false

examples:
  - |
    #include <dt-bindings/clock/qcom,gcc-sm7435.h>
    clock-controller@100000 {
      compatible = "qcom,gcc-sm7435";
      reg = <0x00100000 0x001f4200>;
      clocks = <&xo_19m2>;
      clock-names = "bi_tcxo";
      #clock-cells = <1>;
      #reset-cells = <1>;
      #power-domain-cells = <1>;
    };

...
```

## Documentation/devicetree/bindings/clock/qcom,sm7435-dispcc.yaml
```yaml
# SPDX-License-Identifier: GPL-2.0-only OR BSD-2-Clause
%YAML 1.2
---
$id: http://devicetree.org/schemas/clock/qcom,sm7435-dispcc.yaml#
$schema: http://devicetree.org/meta-schemas/core.yaml#

title: Qualcomm Display Clock & Reset Controller on SM7435

maintainers:
  - ximi <ximiyadka124@proton.me>

description: |
  Qualcomm display clock control module provides the clocks, resets and power
  domains on SM7435.

  See also: include/dt-bindings/clock/qcom,sm7435-dispcc.h

properties:
  compatible:
    const: qcom,sm7435-dispcc

  clocks:
    items:
      - description: Board XO source
      - description: Board active-only XO source
      - description: Sleep clock source
      - description: Byte clock from DSI PHY0
      - description: Pixel clock from DSI PHY0
      - description: Link clock from DP PHY0
      - description: VCO div clock from DP PHY0
      - description: Link clock from DP PHY1
      - description: VCO div clock from DP PHY1
      - description: Link clock from DP PHY2
      - description: VCO div clock from DP PHY2
      - description: Link clock from DP PHY3
      - description: VCO div clock from DP PHY3

  clock-names:
    items:
      - const: bi_tcxo
      - const: bi_tcxo_ao
      - const: sleep_clk
      - const: dsi0_phy_pll_out_byteclk
      - const: dsi0_phy_pll_out_dsiclk
      - const: dp0_phy_pll_link_clk
      - const: dp0_phy_pll_vco_div_clk
      - const: dp1_phy_pll_link_clk
      - const: dp1_phy_pll_vco_div_clk
      - const: dp2_phy_pll_link_clk
      - const: dp2_phy_pll_vco_div_clk
      - const: dp3_phy_pll_link_clk
      - const: dp3_phy_pll_vco_div_clk

  '#clock-cells':
    const: 1

  '#reset-cells':
    const: 1

  '#power-domain-cells':
    const: 1

  reg:
    maxItems: 1

required:
  - compatible
  - reg
  - clocks
  - clock-names
  - '#clock-cells'
  - '#reset-cells'
  - '#power-domain-cells'

additionalProperties: false

examples:
  - |
    clock-controller@af00000 {
        compatible = "qcom,sm7435-dispcc";
        reg = <0x0af00000 0x20000>;
        clocks = <&bi_tcxo>, <&bi_tcxo>, <&sleep_clk>,
                 <&dsi0_phy 0>, <&dsi0_phy 1>,
                 <0>, <0>, <0>, <0>, <0>, <0>, <0>, <0>;
        clock-names = "bi_tcxo", "bi_tcxo_ao", "sleep_clk",
                      "dsi0_phy_pll_out_byteclk",
                      "dsi0_phy_pll_out_dsiclk",
                      "dp0_phy_pll_link_clk", "dp0_phy_pll_vco_div_clk",
                      "dp1_phy_pll_link_clk", "dp1_phy_pll_vco_div_clk",
                      "dp2_phy_pll_link_clk", "dp2_phy_pll_vco_div_clk",
                      "dp3_phy_pll_link_clk", "dp3_phy_pll_vco_div_clk";
        #clock-cells = <1>;
        #reset-cells = <1>;
        #power-domain-cells = <1>;
    };
...
```

## Documentation/devicetree/bindings/display/msm/qcom,sm7435-dpu.yaml
```yaml
# SPDX-License-Identifier: GPL-2.0-only OR BSD-2-Clause
%YAML 1.2
---
$id: http://devicetree.org/schemas/display/msm/qcom,sm7435-dpu.yaml#
$schema: http://devicetree.org/meta-schemas/core.yaml#

title: Qualcomm Display DPU on SM7435

maintainers:
  - ximi <ximiyadka124@proton.me>

$ref: /schemas/display/msm/dpu-common.yaml#

properties:
  compatible:
    const: qcom,sm7435-dpu

  reg:
    items:
      - description: Address offset and size for mdp register set
      - description: Address offset and size for vbif register set

  reg-names:
    items:
      - const: mdp
      - const: vbif

  clocks:
    items:
      - description: Display hf axi clock
      - description: Display ahb clock
      - description: Display lut clock
      - description: Display core clock
      - description: Display vsync clock

  clock-names:
    items:
      - const: bus
      - const: iface
      - const: lut
      - const: core
      - const: vsync

required:
  - compatible
  - reg
  - reg-names
  - clocks
  - clock-names

unevaluatedProperties: false
...
```

## Documentation/devicetree/bindings/display/msm/qcom,sm7435-mdss.yaml
```yaml
# SPDX-License-Identifier: GPL-2.0-only OR BSD-2-Clause
%YAML 1.2
---
$id: http://devicetree.org/schemas/display/msm/qcom,sm7435-mdss.yaml#
$schema: http://devicetree.org/meta-schemas/core.yaml#

title: Qualcomm SM7435 Display MDSS

maintainers:
  - ximi <ximiyadka124@proton.me>

description:
  SM7435 MSM Mobile Display Subsystem (MDSS), which encapsulates sub-blocks
  like the DPU display controller and the DSI interface.

$ref: /schemas/display/msm/mdss-common.yaml#

properties:
  compatible:
    const: qcom,sm7435-mdss

  clocks:
    items:
      - description: Display AHB
      - description: Display hf AXI
      - description: Display core

  clock-names:
    items:
      - const: iface
      - const: bus
      - const: core

  iommus:
    maxItems: 1

  interconnects:
    maxItems: 3

  interconnect-names:
    maxItems: 3

patternProperties:
  "^display-controller@[0-9a-f]+$":
    type: object
    additionalProperties: true

    properties:
      compatible:
        const: qcom,sm7435-dpu

  "^dsi@[0-9a-f]+$":
    type: object
    additionalProperties: true

    properties:
      compatible:
        items:
          - const: qcom,sm8450-dsi-ctrl
          - const: qcom,mdss-dsi-ctrl

  "^phy@[0-9a-f]+$":
    type: object
    additionalProperties: true

    properties:
      compatible:
        const: qcom,sm8450-dsi-phy-5nm

required:
  - compatible

unevaluatedProperties: false
...
```

## Documentation/devicetree/bindings/input/focaltech,ft3683g-spi.yaml
```yaml
# SPDX-License-Identifier: (GPL-2.0-only OR BSD-2-Clause)
%YAML 1.2
---
$id: http://devicetree.org/schemas/input/focaltech,ft3683g-spi.yaml#
$schema: http://devicetree.org/meta-schemas/core.yaml#

title: Focaltech FT3683G touchscreen (SPI)

maintainers:
  - Ximi <ximiyadka124@proton.me>

description: >
  The Focaltech FT3683G is a capacitive touchscreen controller that is
  connected over SPI.  It is used on a number of Qualcomm based smartphones,
  among them the Xiaomi Redmi Note 13 Pro 5G (garnet).

  The chip reports up to ten simultaneous touch points in the "protocol v2"
  format used by this driver.

allOf:
  - $ref: /schemas/spi/spi-consumer.yaml#

properties:
  compatible:
    const: focaltech,n16-3683g-spi

  reg:
    maxItems: 1

  interrupts:
    description: >
      Interrupt line of the touchscreen controller.  If this property is
      missing, the driver derives the interrupt from the
      focaltech,irq-gpio property.
    maxItems: 1

  focaltech,reset-gpio:
    description: >
      GPIO connected to the reset pin of the controller.  The pin is driven
      low and high again to reset the controller during probe and resume.
    maxItems: 1

  focaltech,irq-gpio:
    description: >
      GPIO connected to the interrupt line of the controller.  Only needed
      when the interrupt is not described with the interrupts property.
    maxItems: 1

  focaltech,max-touch-number:
    description: >
      Maximum number of touch points reported by the controller.  Values
      outside of the 2..10 range are clamped.
    default: 10
    maximum: 10
    minimum: 2

  focaltech,super-resolution-factors:
    description: >
      Number of sub-pixel steps the controller reports per touch point.
    default: 1

  focaltech,display-coords:
    description: >
      Resolution of the display the touchscreen is attached to, given as
      x_min, y_min, x_max and y_max.  The values are used to scale the
      coordinates reported by the controller.
    minItems: 4
    maxItems: 4

  focaltech,have-key:
    type: boolean
    description: >
      Indicates that the controller reports keys.  Only supported by the
      vendor driver.

  focaltech,key-number:
    description: Number of keys reported by the controller.
    maximum: 4

  focaltech,keys:
    description: Key codes reported by the controller.
    minItems: 1
    maxItems: 4

  focaltech,key-x-coords:
    description: X coordinates of the keys.
    minItems: 1
    maxItems: 4

  focaltech,key-y-coords:
    description: Y coordinates of the keys.
    minItems: 1
    maxItems: 4

  avdd-supply:
    description: Regulator powering the analog part of the controller.

  iovdd-supply:
    description: Regulator powering the digital I/O part of the controller.

  vddio-supply:
    description: Regulator powering the digital I/O part of the controller.

  vci-supply:
    description: Regulator powering the controller.

additionalProperties: false

required:
  - compatible
  - reg
  - focaltech,display-coords

examples:
  - |
    spi9 {
        compatible = "qcom,spi-geni";
        reg = <0xa8c000 0x4000>;
        interrupts = <0 0x164 0x4>;

        touchscreen@0 {
            compatible = "focaltech,n16-3683g-spi";
            reg = <0>;
            interrupt-parent = <&tlmm>;
            interrupts = <98 IRQ_TYPE_EDGE_FALLING>;

            focaltech,reset-gpio = <&tlmm 96 GPIO_ACTIVE_HIGH>;
            focaltech,irq-gpio = <&tlmm 98 (GPIO_ACTIVE_LOW | GPIO_TRANSITORY)>;

            focaltech,max-touch-number = <10>;
            focaltech,super-resolution-factors = <16>;
            focaltech,display-coords = <0 0 19520 43392>;

            avdd-supply = <&vdd_touch>;
            iovdd-supply = <&vddio_touch>;
        };
    };
...
```

## Documentation/devicetree/bindings/input/touchscreen/focaltech,ft3683g.yaml
```yaml
# SPDX-License-Identifier: (GPL-2.0-only OR BSD-2-Clause)
%YAML 1.2
---
$id: http://devicetree.org/schemas/input/touchscreen/focaltech,ft3683g.yaml#
$schema: http://devicetree.org/meta-schemas/core.yaml#

title: FocalTech FT3683G touchscreen controller

maintainers:
  - Alexander Koskovich <akoskovich@pm.me>

properties:
  compatible:
    const: focaltech,ft3683g

  reg:
    maxItems: 1

  interrupts:
    maxItems: 1

  reset-gpios:
    maxItems: 1

  vci-supply:
    description: Analog power supply

  vddio-supply:
    description: Digital I/O power supply

required:
  - compatible
  - reg
  - interrupts
  - reset-gpios
  - vci-supply
  - vddio-supply
  - touchscreen-size-x
  - touchscreen-size-y

allOf:
  - $ref: touchscreen.yaml#
  - $ref: /schemas/spi/spi-peripheral-props.yaml#

unevaluatedProperties: false

examples:
  - |
    #include <dt-bindings/gpio/gpio.h>
    #include <dt-bindings/interrupt-controller/irq.h>

    spi {
        #address-cells = <1>;
        #size-cells = <0>;

        touchscreen@0 {
            compatible = "focaltech,ft3683g";
            reg = <0>;

            vci-supply = <&vreg_l22b>;
            vddio-supply = <&vreg_l11b>;

            reset-gpios = <&tlmm 20 GPIO_ACTIVE_LOW>;

            interrupt-parent = <&tlmm>;
            interrupts = <19 IRQ_TYPE_EDGE_FALLING>;
            spi-max-frequency = <12000000>;

            touchscreen-size-x = <1080>;
            touchscreen-size-y = <2392>;
        };
    };

...
```
